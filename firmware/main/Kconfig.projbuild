## firmware/main/Kconfig.projbuild
```kconfig
menu "IoT Node Configuration"
    config WIFI_SSID
        string "WiFi SSID"
        default "myssid"
    config WIFI_PASSWORD
        string "WiFi Password"
        default "mypassword"
    config MQTT_BROKER_URI
        string "MQTT Broker URI"
        default "mqtt://user:pass@host:1883"
endmenu
```
